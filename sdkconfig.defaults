## sdkconfig.defaults
```kconfig
# Application configuration

CONFIG_DEVICE_BUTTON1_PIN=1
CONFIG_DEVICE_BUTTON2_PIN=2
CONFIG_DEVICE_BUTTON3_PIN=4
CONFIG_DEVICE_BUTTON4_PIN=5

CONFIG_CALENDAR_ENDPOINT="http://calendarsupport.home/calendar?offset=%d"

CONFIG_DISPLAY_AUTO_OFF_MS=20000
CONFIG_DISPLAY_DOUBLE_FB=y

CONFIG_NETWORK_ENABLE_SNTP=y

CONFIG_IDF_TARGET="esp32s3"

# IT8951

CONFIG_IT8951_CS_PIN=10
CONFIG_IT8951_DISPLAY_READY_PIN=8
CONFIG_IT8951_MISO_PIN=13
CONFIG_IT8951_MOSI_PIN=11
CONFIG_IT8951_RESET_PIN=9
CONFIG_IT8951_SCLK_PIN=12
CONFIG_IT8951_SPI_HOST=2

# LVGL

CONFIG_LV_ASSERT_HANDLER_INCLUDE="../../../../main/lvgl_assert.h"
CONFIG_LV_CONF_MINIMAL=y
CONFIG_LV_DPI_DEF=220
CONFIG_LV_FONT_DEFAULT_MONTSERRAT_8=y
CONFIG_LV_FONT_MONTSERRAT_8=y
CONFIG_LV_LABEL_LONG_TXT_HINT=y
CONFIG_LV_LABEL_TEXT_SELECTION=y
CONFIG_LV_LOG_LEVEL_WARN=y
CONFIG_LV_LOG_LEVEL=2
CONFIG_LV_LOG_TRACE_ANIM=y
CONFIG_LV_LOG_TRACE_DISP_REFR=y
CONFIG_LV_LOG_TRACE_EVENT=y
CONFIG_LV_LOG_TRACE_INDEV=y
CONFIG_LV_LOG_TRACE_LAYOUT=y
CONFIG_LV_LOG_TRACE_MEM=y
CONFIG_LV_LOG_TRACE_OBJ_CREATE=y
CONFIG_LV_LOG_TRACE_TIMER=y
CONFIG_LV_MEM_CUSTOM_INCLUDE="stdlib.h"
CONFIG_LV_MEM_CUSTOM=y
CONFIG_LV_MEMCPY_MEMSET_STD=y
CONFIG_LV_THEME_DEFAULT_TRANSITION_TIME=0
CONFIG_LV_TXT_BREAK_CHARS=" "
CONFIG_LV_TXT_ENC_UTF8=y
CONFIG_LV_USE_ARC=y
CONFIG_LV_USE_ASSERT_MALLOC=y
CONFIG_LV_USE_ASSERT_NULL=y
CONFIG_LV_USE_ASSERT_STYLE=y
CONFIG_LV_USE_BAR=y
CONFIG_LV_USE_BTN=y
CONFIG_LV_USE_BTNMATRIX=y
CONFIG_LV_USE_CALENDAR_HEADER_ARROW=y
CONFIG_LV_USE_CALENDAR_HEADER_DROPDOWN=y
CONFIG_LV_USE_CALENDAR=y
CONFIG_LV_USE_CANVAS=y
CONFIG_LV_USE_CHART=y
CONFIG_LV_USE_CHECKBOX=y
CONFIG_LV_USE_COLORWHEEL=y
CONFIG_LV_USE_DROPDOWN=y
CONFIG_LV_USE_FLEX=y
CONFIG_LV_USE_GRID=y
CONFIG_LV_USE_IMG=y
CONFIG_LV_USE_IMGBTN=y
CONFIG_LV_USE_KEYBOARD=y
CONFIG_LV_USE_LABEL=y
CONFIG_LV_USE_LED=y
CONFIG_LV_USE_LINE=y
CONFIG_LV_USE_LIST=y
CONFIG_LV_USE_LOG=y
CONFIG_LV_USE_MENU=y
CONFIG_LV_USE_METER=y
CONFIG_LV_USE_MSGBOX=y
CONFIG_LV_USE_ROLLER=y
CONFIG_LV_USE_SLIDER=y
CONFIG_LV_USE_SPAN=y
CONFIG_LV_USE_SPINBOX=y
CONFIG_LV_USE_SPINNER=y
CONFIG_LV_USE_SWITCH=y
CONFIG_LV_USE_TABLE=y
CONFIG_LV_USE_TABVIEW=y
CONFIG_LV_USE_TEXTAREA=y
CONFIG_LV_USE_THEME_BASIC=y
CONFIG_LV_USE_THEME_DEFAULT=y
CONFIG_LV_USE_TILEVIEW=y


# Setup flash

CONFIG_ESPTOOLPY_FLASHSIZE_8MB=y
CONFIG_PARTITION_TABLE_CUSTOM=y

# SPIRAM

CONFIG_SPIRAM=y
CONFIG_SPIRAM_FETCH_INSTRUCTIONS=y
CONFIG_SPIRAM_RODATA=y
CONFIG_SPIRAM_SPEED_80M=y

# MQTT

CONFIG_MQTT_TOPIC_PREFIX="pieter"
CONFIG_MQTT_DEVICE_MANUFACTURER="Pieter"
CONFIG_MQTT_DEVICE_MODEL="Calendar Display"
CONFIG_MQTT_DEVICE_MODEL_ID="Calendar Display v1"
```
